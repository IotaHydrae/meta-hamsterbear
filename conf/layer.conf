## conf/layer.conf
```bitbake
# We have a conf and classes directory, add to BBPATH
BBPATH .= ":${LAYERDIR}"

# We have recipes-* directories, add to BBFILES
BBFILES += "${LAYERDIR}/recipes-*/*/*.bb \
            ${LAYERDIR}/recipes-*/*/*.bbappend"

BBFILE_COLLECTIONS += "meta-hamsterbear"
BBFILE_PATTERN_meta-hamsterbear = "^${LAYERDIR}/"
BBFILE_PRIORITY_meta-hamsterbear = "6"

LAYERDEPENDS_meta-hamsterbear = "core"
LAYERSERIES_COMPAT_meta-hamsterbear = "thud"
```
